## app/boards/arm/nice_nano/Kconfig.defconfig
```kconfig
# Copyright (c) 2021 The ZMK Contributors
# SPDX-License-Identifier: MIT

if BOARD_NICE_NANO || BOARD_NICE_NANO_V2

config BOARD
    default "nice_nano"

if USB_DEVICE_STACK

config USB_NRFX
    default y

endif # USB_DEVICE_STACK

config ZMK_DISPLAY
    select LV_USE_LABEL
    select LV_USE_IMG

config BT_CTLR
    default BT

endif # BOARD_NICE_NANO || BOARD_NICE_NANO_V2
```
